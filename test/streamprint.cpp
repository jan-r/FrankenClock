/*
 * This file is part of the FrankenClock project. It is licensed under the
 * BSD 3-clause license.
 *
 * Copyright 2018 Jan Reucker
 *
 * Redistribution and use in source and binary forms, with or without modification,
 * are permitted provided that the following conditions are met:
 *
 * 1. Redistributions of source code must retain the above copyright notice, this
 *    list of conditions and the following disclaimer.
 *
 * 2. Redistributions in binary form must reproduce the above copyright notice,
 *    this list of conditions and the following disclaimer in the documentation
 *    and/or other materials provided with the distribution.
 *
 * 3. Neither the name of the copyright holder nor the names of its contributors
 *    may be used to endorse or promote products derived from this software
 *    without specific prior written permission.
 *
 * THIS SOFTWARE IS PROVIDED BY THE COPYRIGHT HOLDERS AND CONTRIBUTORS "AS IS"
 * AND ANY EXPRESS OR IMPLIED WARRANTIES, INCLUDING, BUT NOT LIMITED TO, THE
 * IMPLIED WARRANTIES OF MERCHANTABILITY AND FITNESS FOR A PARTICULAR PURPOSE ARE
 * DISCLAIMED. IN NO EVENT SHALL THE COPYRIGHT HOLDER OR CONTRIBUTORS BE LIABLE
 * FOR ANY DIRECT, INDIRECT, INCIDENTAL, SPECIAL, EXEMPLARY, OR CONSEQUENTIAL
 * DAMAGES (INCLUDING, BUT NOT LIMITED TO, PROCUREMENT OF SUBSTITUTE GOODS OR
 * SERVICES; LOSS OF USE, DATA, OR PROFITS; OR BUSINESS INTERRUPTION) HOWEVER
 * CAUSED AND ON ANY THEORY OF LIABILITY, WHETHER IN CONTRACT, STRICT LIABILITY,
 * OR TORT (INCLUDING NEGLIGENCE OR OTHERWISE) ARISING IN ANY WAY OUT OF THE USE
 * OF THIS SOFTWARE, EVEN IF ADVISED OF THE POSSIBILITY OF SUCH DAMAGE.
 */

/*
 * Usage: streamprint stream.txt
 *
 * Visualizes the captured sampling output from stream.txt on the console.
 * Sampling output is generated by the FrankenClock if PRINT_BITSTREAM is
 * defined in Sampler.cpp. The bitstream is printed as hexadecimal characters;
 * groups of 4 consecutive bits form one character, with the MSB being the
 * oldest bit. So, the bitstream 0001 will be represented as '1' and 1010 will
 * be represented as 'A'. A zero bit will be visualized as '.' and a one bit
 * as '*'. Therefore, the stream 03FFC0 will be visualized as
 * ......************......
 */ 

#include <cstdio>
#include <cstdlib>
#include "StreamReader.h"

int main(int argc, char** argv)
{
  StreamReader *sr;

  if (argc != 2)
  {
    fprintf(stderr, "Usage: streamprint streamlog.txt\n");
    return EXIT_FAILURE;
  }

  try
  {
    sr = new StreamReader(argv[1]);
  }
  catch (const std::runtime_error& e)
  {
    fprintf(stderr, "*** error: %s\n", e.what());
    return EXIT_FAILURE;
  }
  
  int value;
  int bitcounter = 0;
  while ((value = sr->getNextSample()) >= 0)
  {
    if (value)
    {
      putchar('*');
    }
    else
    {
      putchar('.');
    }

    // add a line break every 100 bits
    if (++bitcounter >= 100)
    {
      bitcounter = 0;
      putchar('\n');
    }
  }
  putchar('\n');

  return EXIT_SUCCESS;
}

